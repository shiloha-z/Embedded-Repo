# include "message.h"
#include <stdio.h>
#include <string.h> // for memcpy
#include <stdlib.h> // for malloc
#include "mbedtls/aes.h"
#include "esp_random.h"
#include "esp_log.h"

typedef uint8_t UCHAR;
typedef uint16_t USHORT;

USHORT usMBCRC16( UCHAR * pucFrame, USHORT usLen );

static const UCHAR aucCRCHi[] = {

    0x00, 0xC1, 0x81, 0x40, 0x01, 0xC0, 0x80, 0x41, 0x01, 0xC0, 0x80, 0x41,

    0x00, 0xC1, 0x81, 0x40, 0x01, 0xC0, 0x80, 0x41, 0x00, 0xC1, 0x81, 0x40,
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    0x00, 0xC1, 0x81, 0x40

};
static const UCHAR aucCRCLo[] = {

    0x00, 0xC0, 0xC1, 0x01, 0xC3, 0x03, 0x02, 0xC2, 0xC6, 0x06, 0x07, 0xC7,

0x05, 0xC5, 0xC4, 0x04, 0xCC, 0x0C, 0x0D, 0xCD, 0x0F, 0xCF, 0xCE, 0x0E,
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    0x41, 0x81, 0x80, 0x40

};

void message_creat(uint8_t **out_msg, uint16_t MsgLen, uint16_t MsgType, uint64_t Badge_ID, uint64_t Employee_ID, uint8_t *data) {
    // 分配足够的空间来存储整个消息
    *out_msg = (uint8_t *)malloc(MsgLen);
    if (*out_msg == NULL) {
        // 处理内存分配失败的情况
        return;
    }

    // 临时指针用于操作
    uint8_t *ptr = *out_msg;

    // 将MsgLen转换为大端序并拷贝到输出报文中
    ptr[0] = (MsgLen >> 8) & 0xFF;
    ptr[1] = MsgLen & 0xFF;
    ptr += sizeof(MsgLen);

    // 将MsgType转换为大端序并拷贝到输出报文中
    ptr[0] = (MsgType >> 8) & 0xFF;
    ptr[1] = MsgType & 0xFF;
    ptr += sizeof(MsgType);

    memcpy(ptr, &Badge_ID, sizeof(Badge_ID));
    ptr += sizeof(Badge_ID);

    memcpy(ptr, &Employee_ID, sizeof(Employee_ID));
    ptr += sizeof(Employee_ID);

    if (data != NULL) {
        memcpy(ptr, data, MsgLen - 21);
        ptr += MsgLen - 22;
    }

    // 计算 CRC16 校验码
    uint16_t crc = usMBCRC16(*out_msg, MsgLen - 2);

    // 将CRC16转换为大端序并拷贝到输出报文中
    ptr[0] = (crc >> 8) & 0xFF;
    ptr[1] = crc & 0xFF;
}

bool message_processing(uint8_t *in_msg, uint16_t MsgLen,uint16_t variable_data_len)//返回校验是否正确
{
    uint16_t CRC16 = in_msg[20 + variable_data_len] << 8 | in_msg[21 + variable_data_len];
    uint16_t crc = usMBCRC16(in_msg, MsgLen - 2);
    if(CRC16==crc)
        return true;
    else
        return false;
}

USHORT usMBCRC16( UCHAR * pucFrame, USHORT usLen )
{
    UCHAR ucCRCHi = 0xFF;
    UCHAR ucCRCLo = 0xFF;
    int iIndex;
    while( usLen-- )
    {
        iIndex = ucCRCLo ^ *( pucFrame++ );
        ucCRCLo = ( UCHAR )( ucCRCHi ^ aucCRCHi[iIndex] );
        ucCRCHi = aucCRCLo[iIndex];
    }
    return ( USHORT )( ucCRCHi << 8 | ucCRCLo );
}

void generate_random_iv(unsigned char *iv, size_t length) {
    for (size_t i = 0; i < length; i++) {
        iv[i] = esp_random() % 256; // 生成随机字节
    }
}

void aes_encrypt_decrypt(const uint8_t *key, const uint8_t *input_text, size_t input_len, int mode, unsigned char *output_text, unsigned char *iv) {
    // 初始化向量 (IV) (16 bytes for AES-CBC)
    // if (mode == 0) { // 仅在加密时生成随机IV
    //     generate_random_iv(iv, 16);
    // }
        unsigned char fixed_iv[16] = {
        0x00, 0x01, 0x02, 0x03, 0x04, 0x05, 0x06, 0x07,
        0x08, 0x09, 0x0A, 0x0B, 0x0C, 0x0D, 0x0E, 0x0F
    };
    memcpy(iv, fixed_iv, 16);

    // 上下文初始化
    mbedtls_aes_context aes;
    mbedtls_aes_init(&aes);

    size_t padded_len = ((input_len + 15) / 16) * 16; // 计算填充后的长度
    unsigned char *padded_input = (unsigned char *)malloc(padded_len);
    memcpy(padded_input, input_text, input_len);

    if (mode == 1) {
        // PKCS#7 填充
        unsigned char padding_value = padded_len - input_len;
        for (size_t i = input_len; i < padded_len; i++) {
            padded_input[i] = padding_value;
        }
        // 设置加密密钥
        mbedtls_aes_setkey_enc(&aes, key, 256);
    } else {
        // 设置解密密钥
        mbedtls_aes_setkey_dec(&aes, key, 256);
    }

    unsigned char iv_copy[16];
    memcpy(iv_copy, iv, 16);

    // 进行AES-CBC加密或解密
    mbedtls_aes_crypt_cbc(&aes, mode, padded_len, iv_copy, padded_input, output_text);

    // 如果是解密，去除填充
    if (mode != 0) {
        unsigned char padding_value = output_text[padded_len - 1];
        if (padding_value <= 16) {
            padded_len -= padding_value;
        }
    }

    // 释放资源
    mbedtls_aes_free(&aes);
    free(padded_input);
}

void TLV_message_creat(uint8_t **out_TLV, uint16_t Tag ,uint16_t ValueLen,uint8_t *Value) {
    // 分配足够的空间来存储整个消息
    *out_TLV = (uint8_t *)malloc(ValueLen+4);
    if (*out_TLV == NULL) {
        // 处理内存分配失败的情况
        return;
    }
    // 临时指针用于操作
    uint8_t *ptr = *out_TLV;

    // 将MsgLen转换为大端序并拷贝到输出报文中
    ptr[0] = (Tag >> 8) & 0xFF;
    ptr[1] = Tag & 0xFF;
    ptr += sizeof(Tag);

    // 将MsgType转换为大端序并拷贝到输出报文中
    ptr[0] = (ValueLen >> 8) & 0xFF;
    ptr[1] = ValueLen & 0xFF;
    ptr += sizeof(ValueLen);

    memcpy(ptr, Value, ValueLen);
}