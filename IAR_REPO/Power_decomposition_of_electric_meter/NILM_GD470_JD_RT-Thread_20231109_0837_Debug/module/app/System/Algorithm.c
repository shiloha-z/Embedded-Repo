//----------------------------------------------------------------------
//Copyright (C) 2003-20XX 烟台东方威思顿电气有限公司电表软件研发部
//创建人	
//创建日期	
//描述		
//修改记录
//----------------------------------------------------------------------
#include "AllHead.h"
#include <rtthread.h>

//-----------------------------------------------
//			本文件使用的宏定义
//-----------------------------------------------

//-----------------------------------------------
//		本文件使用的结构体，共用体，枚举
//-----------------------------------------------
AMessage_T xMessage;
AMessage_T xRxedStructure; 
//-----------------------------------------------
//				全局使用的变量，常量
//-----------------------------------------------
DWORD xStructQueue = NULL;
//-----------------------------------------------
//				本文件使用的变量，常量		
//-----------------------------------------------

//-----------------------------------------------
//				内部函数声明
//-----------------------------------------------

//-----------------------------------------------
//				函数定义
//-----------------------------------------------
//--------------------------------------------------
//功能描述:  创建一个消息队列
//         
//参数:      
//         
//返回值:    
//         
//备注:  
//--------------------------------------------------
void vCreateQueues(void)
{
	xMessage.ucMessageID = 0x00;
	memset(&(xMessage.ucData), 0x00, 20);

	xStructQueue = xQueueCreate(sizeof(xMessage), 10);

	if(xStructQueue == NULL){

	}
}
//--------------------------------------------------
//功能描述:  算法处理模块
//         
//参数:      
//         
//返回值:    
//         
//备注:  
//--------------------------------------------------
void Algorithm (void)
{
	for(;;){
		CLEAR_WATCH_DOG;
		/*NILM主任务*/
		api_NILM_Task();
		rt_thread_mdelay(1);
	}
}
//--------------------------------------------------
//功能描述:  算法处理接口
//         
//参数:      
//         
//返回值:    
//         
//备注:  
//--------------------------------------------------
void vCreatTasktoCalc(void)
{
	int xReturned;
	int* xHandle = NULL;

	/* Create the task, storing the handle. */
	xReturned = xTaskCreate(
					Algorithm,       /* Function that implements the task. */
					"algroithm",          /* Text name for the task. */
					1024*10,      /* Stack size in words, not bytes. */
					NULL,    /* Parameter passed into the task. */
					11,/* Priority at which the task is created. */
					&xHandle);      /* Used to pass out the created task's handle. */

	if( xReturned == 0 ){

	}
}
